## drivers/ddr/imx/phy/Kconfig
```kconfig
config IMX_SNPS_DDR_PHY
	bool "i.MX Snopsys DDR PHY"
	help
	  Select the DDR PHY driver support on i.MX8M and i.MX9 SOC.

config IMX_SNPS_DDR_PHY_QB_GEN
	bool "i.MX Synopsys DDR PHY training data saving for QuickBoot mode"
	depends on IMX94 || IMX95
	help
	  Select the DDR PHY training data saving for
	  QuickBoot support on i.MX9 SOC.
```

## lib/efi_driver/Kconfig
```kconfig
config EFI_GBL_AVB
	bool "Include GBL AVB protocol"
	depends on EFI_LOADER
	help
	  Include the driver for the custom GBL AVB protocol. This protocol
	  allows to delegate device-specific Android verified booot (AVB)
	  logic to the firmware.
```
